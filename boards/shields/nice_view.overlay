&spi1 {
    status = "okay";
    nice_view: nice_view@0 {
        compatible = "nice,nice_view"; 
        cs-gpios = <&gpio0 15 GPIO_ACTIVE_LOW>; 
        dc-gpios = <&gpio0 16 GPIO_ACTIVE_HIGH>;
        reset-gpios = <&gpio0 17 GPIO_ACTIVE_LOW>;
        width = <128>;
        height = <64>;
        rotation = <0>;
    };
};
